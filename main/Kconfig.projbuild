## main/Kconfig.projbuild
```kconfig
menu "Teleinfo Configuration"

    config TIC_UART_GPIO
        int "GPIO pour réception UART du module d'interface TIC"
        default 2

    config TIC_LED_GPIO
        int "GPIO pour la LED du module d'interface TIC"
        default 3

    choice TIC_WIFI_SCAN_AUTH_MODE_THRESHOLD
        prompt "WiFi Scan auth mode threshold"
        default TIC_WIFI_AUTH_OPEN
        help
            The weakest authmode to accept in the scan mode.

        config TIC_WIFI_AUTH_OPEN
            bool "OPEN"
        config TIC_WIFI_AUTH_WEP
            bool "WEP"
        config TIC_WIFI_AUTH_WPA_PSK
            bool "WPA PSK"
        config TIC_WIFI_AUTH_WPA2_PSK
            bool "WPA2 PSK"
        config TIC_WIFI_AUTH_WPA_WPA2_PSK
            bool "WPA/WPA2 PSK"
        config TIC_WIFI_AUTH_WPA3_PSK
            bool "WPA3 PSK"
        config TIC_WIFI_AUTH_WPA2_WPA3_PSK
            bool "WPA2/WPA3 PSK"
        config TIC_WIFI_AUTH_WAPI_PSK
            bool "WAPI PSK"
    endchoice
 
    config TIC_OLED_DISPLAY
        bool "Enable SSD1306 display support"
        default n
        help
            Enable SSD1306 128x64 I2C display
            Use LCDGFX library

    config TIC_OLED_DISPLAY_SCL
        int 
        prompt "GPIO pin for SCL"
        depends on TIC_OLED_DISPLAY
        default 0

    config TIC_OLED_DISPLAY_SDA
        int 
        prompt "GPIO pin for SDA"
        depends on TIC_OLED_DISPLAY
        default 1

    config TIC_OLED_DISPLAY_ADDR
        hex
        prompt "SSD1306 display I2C address"
        default 0x3C
        depends on TIC_OLED_DISPLAY
        help
            Adresse I2C hexadecimale (0x3C ou 0x3D)

    config TIC_CONSOLE
        bool "Enable serial console interface"
        default y

    config TIC_SNTP
        bool "Enable sntp time synchronisation"
        default y

    config TIC_SNTP_SERVER
        string "SNTP server name"
        depends on TIC_SNTP
        default "fr.pool.ntp.org"


endmenu
```

## src/Kconfig.projbuild
```kconfig
menu "Teleinfo Configuration"

    choice TIC_WIFI_SCAN_AUTH_MODE_THRESHOLD
        prompt "WiFi Scan auth mode threshold"
        default TIC_WIFI_AUTH_OPEN
        help
            The weakest authmode to accept in the scan mode.

        config TIC_WIFI_AUTH_OPEN
            bool "OPEN"
        config TIC_WIFI_AUTH_WEP
            bool "WEP"
        config TIC_WIFI_AUTH_WPA_PSK
            bool "WPA PSK"
        config TIC_WIFI_AUTH_WPA2_PSK
            bool "WPA2 PSK"
        config TIC_WIFI_AUTH_WPA_WPA2_PSK
            bool "WPA/WPA2 PSK"
        config TIC_WIFI_AUTH_WPA3_PSK
            bool "WPA3 PSK"
        config TIC_WIFI_AUTH_WPA2_WPA3_PSK
            bool "WPA2/WPA3 PSK"
        config TIC_WIFI_AUTH_WAPI_PSK
            bool "WAPI PSK"
    endchoice

    config TIC_BROKER_URL
        string "MQTT broker URL"
        default "mqtt://192.168.1.131"
        help
            URL of the broker to connect to

    config TIC_BROKER_PSK_INDENITY
        string "TLS-PSK identity"
        default ""
        help
            Identite pour l'authentification PSK

    config TIC_BROKER_PSK_KEY
        string "TLS-PSK key"
        default "{ 0x12, 0x34, 0x56 }"
        help
            Clé secrete l'authentification PSK au format C - exemple { 0x12, 0x34, 0x56 }

    config TIC_BROKER_URL_FROM_STDIN
        bool
        default y if BROKER_URL = "FROM_STDIN"

endmenu
```
